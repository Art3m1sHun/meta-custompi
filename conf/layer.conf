## conf/layer.conf
```bitbake
# We have a conf and classes directory, add to BBPATH
BBPATH .= ":${LAYERDIR}"

# We have recipes-* directories, add to BBFILES
BBFILES += "${LAYERDIR}/recipes-*/*/*.bb \
            ${LAYERDIR}/recipes-*/*/*.bbappend"

BBFILE_COLLECTIONS += "meta-custompi02w"
BBFILE_PATTERN_meta-custompi02w = "^${LAYERDIR}/"
BBFILE_PRIORITY_meta-custompi02w = "6"

LAYERDEPENDS_meta-custompi02w = "core"
LAYERSERIES_COMPAT_meta-custompi02w = "scarthgap"
```
